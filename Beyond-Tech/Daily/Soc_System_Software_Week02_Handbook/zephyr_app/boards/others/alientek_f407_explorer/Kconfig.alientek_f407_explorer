## Beyond-Tech/Daily/Soc_System_Software_Week02_Handbook/zephyr_app/boards/others/alientek_f407_explorer/board.yml
```yaml
board:
  name: alientek_f407_explorer
  full_name: ALIENTEK Explorer STM32F407
  vendor: others
  socs:
    - name: stm32f407xx
```
